## config/west.yml
```yaml
manifest:
  defaults:
    revision: main
  remotes:
    - name: zmkfirmware
      url-base: https://github.com/zmkfirmware
    # Additional modules containing boards/shields/custom code can be listed here as well
    # See https://docs.zephyrproject.org/3.2.0/develop/west/manifest.html#projects
    - name: badjeff
      url-base: https://github.com/badjeff
    - name: george-norton
      url-base: https://github.com/george-norton
  projects:
    - name: zmk
      remote: zmkfirmware
      import: app/west.yml
    - name: zmk-pmw3610-driver
      remote: badjeff
      revision: main
    - name: zmk-behavior-sensor-attr-cycle
      remote: george-norton
      revision: main
    - name: zmk-input-processor-report-rate-limit
      remote: badjeff
      revision: main

  self:
    path: config
```
