## boards/shields/comet/Kconfig.defconfig
```kconfig
# Copyright (c) 2026 The ZMK Contributors
# SPDX-License-Identifier: MIT

if SHIELD_COMET_LEFT

config ZMK_KEYBOARD_NAME
    default "Comet"

config ZMK_SPLIT_ROLE_CENTRAL
    default n

endif

if SHIELD_COMET_RIGHT

config ZMK_KEYBOARD_NAME
    default "Comet"

config ZMK_SPLIT_ROLE_CENTRAL
    default y

endif

if SHIELD_COMET_LEFT || SHIELD_COMET_RIGHT

config ZMK_SPLIT
    default y

endif
```

## boards/shields/comet/Kconfig.shield
```kconfig
# Copyright (c) 2026 The ZMK Contributors
# SPDX-License-Identifier: MIT

config SHIELD_COMET_LEFT
    def_bool $(shields_list_contains,comet_left)

config SHIELD_COMET_RIGHT
    def_bool $(shields_list_contains,comet_right)
```
